## drivers/misc/inv_mpu/accel/Kconfig
```kconfig
menuconfig INV_SENSORS_ACCELEROMETERS
	bool "Accelerometer Slave Sensors"
	default y
	---help---
	  Say Y here to get to see options for device drivers for various
	  accelerometrs for integration with the MPU3050 or MPU6050 driver.
	  This option alone does not add any kernel code.

	  If you say N, all options in this submenu will be skipped and disabled.

if INV_SENSORS_ACCELEROMETERS

config MPU_SENSORS_KXTF9
	tristate "Kionix KXTF9"
	depends on MPU_SENSORS_MPU3050 || MPU_SENSORS_MPU6050B1 || MPU_SENSORS_MPU6050A2
	help
	  This enables support for the Kionix KXFT9 accelerometer
	  This support is for integration with the MPU3050 gyroscope device
	  driver.  Only one accelerometer can be registered at a time.
	  Specifying more that one accelerometer in the board file will result
	  in runtime errors.

endif
```

## drivers/misc/mpu3050/Kconfig
```kconfig
menu "Motion Sensors Support"

choice
    tristate "Motion Processing Unit"
    depends on I2C
    default MPU_NONE

config MPU_NONE
    bool "None"
    help
      This disables support for motion processing using the MPU family of
      motion processing units.

config MPU_SENSORS_MPU3050
    tristate "MPU3050"
    depends on I2C
    help
      If you say yes here you get support for the MPU3050 Gyroscope driver
      This driver can also be built as a module.  If so, the module
      will be called mpu3050.

config MPU_SENSORS_MPU6000
    tristate "MPU6000"
    depends on I2C
    help
      If you say yes here you get support for the MPU6000 Gyroscope driver
      This driver can also be built as a module.  If so, the module
      will be called mpu6000.

endchoice

choice
    prompt "Accelerometer Type"
    depends on MPU_SENSORS_MPU3050
    default MPU_SENSORS_KXTF9

config MPU_SENSORS_ACCELEROMETER_NONE
    bool "NONE"
    depends on MPU_SENSORS_MPU3050 || MPU_SENSORS_MPU6000
    help
      This disables accelerometer support for the MPU3050

config MPU_SENSORS_KXTF9
    bool "Kionix KXTF9"
    depends on MPU_SENSORS_MPU3050
    help
      This enables support for the Kionix KXFT9 accelerometer

endchoice

choice
    prompt "Compass Type"
    depends on MPU_SENSORS_MPU6000 || MPU_SENSORS_MPU3050
    default MPU_SENSORS_AMI304

config MPU_SENSORS_COMPASS_NONE
    bool "NONE"
    depends on MPU_SENSORS_MPU6000 || MPU_SENSORS_MPU3050
    help
      This disables compass support for the MPU6000

config MPU_SENSORS_AMI304
    bool "AMIT AMI304"
    depends on MPU_SENSORS_MPU6000 || MPU_SENSORS_MPU3050
    help
      This enables support for the AMIT AMI304 compass

endchoice

choice
    prompt "Pressure Type"
    depends on MPU_SENSORS_MPU6000 || MPU_SENSORS_MPU3050
    default MPU_SENSORS_PRESSURE_NONE

config MPU_SENSORS_PRESSURE_NONE
    bool "NONE"
    depends on MPU_SENSORS_MPU6000 || MPU_SENSORS_MPU3050
    help
      This disables pressure sensor support for the MPU6000

endchoice

config MPU_SENSORS_TIMERIRQ
    tristate "Timer IRQ"
    help
    If you say yes here you get access to the timerirq device handle which
    can be used to select on. This can be used instead of IRQ's, sleeping,
    or timer threads. Reading from this device returns the same type of
    information as reading from the MPU and slave IRQ's.

config MPU_SENSORS_DEBUG
    bool "MPU debug"
    depends on MPU_SENSORS_MPU3050 || MPU_SENSORS_MPU6000 || MPU_SENSORS_TIMERIRQ
    help
      If you say yes here you get extra debug messages from the MPU3050
      and other slave sensors.

endmenu
```

## drivers/ril/Kconfig
```kconfig
config RIL
	tristate "The RIL driver"
	help
		A simple RIL driver to listen or control the GPIO of RIL.
```

## fs/f2fs/Kconfig
```kconfig
config F2FS_FS
	tristate "F2FS filesystem support (EXPERIMENTAL)"
	depends on EXPERIMENTAL
	help
	  F2FS is based on Log-structured File System (LFS), which supports
	  versatile "flash-friendly" features. The design has been focused on
	  addressing the fundamental issues in LFS, which are snowball effect
	  of wandering tree and high cleaning overhead.

	  Since flash-based storages show different characteristics according to
	  the internal geometry or flash memory management schemes aka FTL, F2FS
	  and tools support various parameters not only for configuring on-disk
	  layout, but also for selecting allocation and cleaning algorithms.

	  If unsure, say N.

config F2FS_STAT_FS
	bool "F2FS Status Information"
	depends on F2FS_FS
	default y
	help
	  /proc/fs/f2fs/ contains information about partitions mounted as f2fs.
	  For each partition, a corresponding directory, named as its device
	  name, is provided with the following proc entries.

	  f2fs_stat	major file system information managed by f2fs currently
	  f2fs_sit_stat	average SIT information about whole segments
	  f2fs_mem_stat	current memory footprint consumed by f2fs

	  e.g., in /proc/fs/f2fs/sdb1/

config F2FS_FS_XATTR
	bool "F2FS extended attributes"
	depends on F2FS_FS
	default y
	help
	  Extended attributes are name:value pairs associated with inodes by
	  the kernel or by users (see the attr(5) manual page, or visit
	  <http://acl.bestbits.at/> for details).

	  If unsure, say N.

config F2FS_FS_POSIX_ACL
	bool "F2FS Access Control Lists"
	depends on F2FS_FS_XATTR
	select FS_POSIX_ACL
	default y
	help
	  Posix Access Control Lists (ACLs) support permissions for users and
	  gourps beyond the owner/group/world scheme.

	  To learn more about Access Control Lists, visit the POSIX ACLs for
	  Linux website <http://acl.bestbits.at/>.

	  If you don't know what Access Control Lists are, say N
```
